#include "FontGB2312.h"

struct Glyph16 {
  uint16_t code;
  uint16_t row[16];
};

static const Glyph16 kGlyphs[] PROGMEM = {
  {0x4E0B, {0x7FFE,0x7FFE,0x0180,0x0180,0x0180,0x01E0,0x01F8,0x01BC,0x019C,0x0180,0x0180,0x0180,0x0180,0x0180,0x0180,0x0000}},
  {0x4E0D, {0x7FFE,0x7FFE,0x01C0,0x0380,0x0380,0x07F0,0x0FB8,0x1D9C,0x798E,0x7186,0x0180,0x0180,0x0180,0x0180,0x0180,0x0000}},
  {0x4F59, {0x0180,0x03C0,0x07E0,0x0E70,0x3C3C,0x7FFF,0x6FF2,0x0180,0x3FFC,0x3FFE,0x0180,0x19B0,0x1998,0x718C,0x678E,0x0700}},
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  {0xFF0C, {0x0000,0x0000,0x0000,0x0000,0x0800,0x1C00,0x1C00,0x0C00,0x0C00,0x1800,0x1000,0x0000,0x0000,0x0000,0x0000,0x0000}}
};

static const size_t kGlyphCount = sizeof(kGlyphs) / sizeof(kGlyphs[0]);

static uint32_t utf8Next(const char* s, size_t& i) {
  uint8_t c = static_cast<uint8_t>(s[i++]);
  if (c < 0x80) return c;
  if ((c & 0xE0) == 0xC0) {
    uint8_t c1 = static_cast<uint8_t>(s[i++]);
    return ((uint32_t)(c & 0x1F) << 6) | (c1 & 0x3F);
  }
  if ((c & 0xF0) == 0xE0) {
    uint8_t c1 = static_cast<uint8_t>(s[i++]);
    uint8_t c2 = static_cast<uint8_t>(s[i++]);
    return ((uint32_t)(c & 0x0F) << 12) |
           ((uint32_t)(c1 & 0x3F) << 6) | (c2 & 0x3F);
  }
  if ((c & 0xF8) == 0xF0) {
    uint8_t c1 = static_cast<uint8_t>(s[i++]);
    uint8_t c2 = static_cast<uint8_t>(s[i++]);
    uint8_t c3 = static_cast<uint8_t>(s[i++]);
    return ((uint32_t)(c & 0x07) << 18) |
           ((uint32_t)(c1 & 0x3F) << 12) |
           ((uint32_t)(c2 & 0x3F) << 6) |
           (c3 & 0x3F);
  }
  return '?';
}

static const Glyph16* findGlyph(uint32_t code) {
  for (size_t i = 0; i < kGlyphCount; ++i) {
    if (pgm_read_word(&kGlyphs[i].code) == code) return &kGlyphs[i];
  }
  return nullptr;
}

static int16_t glyphWidth(uint32_t code, uint8_t scale) {
  return (code >= 0x80) ? (16 * scale) : (8 * scale);
}

int16_t FontGB2312::textWidth(const String& text, uint8_t scale) {
  if (scale == 0) scale = 1;
  int16_t width = 0;
  const char* s = text.c_str();
  size_t i = 0;
  while (s[i]) {
    uint32_t code = utf8Next(s, i);
    if (code == '\n' || code == '\r') continue;
    width += glyphWidth(code, scale);
  }
  return width;
}

static void drawGlyph(TFT_eSprite& sprite, int16_t x, int16_t y,
                      uint32_t code, uint16_t color, uint16_t bg,
                      uint8_t scale) {
  if (code < 0x80) {
    if (code == ' ') {
      sprite.fillRect(x, y, 8 * scale, 16 * scale, bg);
      return;
    }
    sprite.drawChar(x, y, (char)code, color, bg, scale);
    return;
  }

  const Glyph16* g = findGlyph(code);
  if (!g) {
    sprite.drawRect(x, y, 16 * scale - 1, 16 * scale - 1, color);
    return;
  }

  for (uint8_t row = 0; row < 16; ++row) {
    uint16_t bits = pgm_read_word(&g->row[row]);
    for (uint8_t col = 0; col < 16; ++col) {
      if (bits & (0x8000u >> col)) {
        if (scale == 1) {
          sprite.drawPixel(x + col, y + row, color);
        } else {
          sprite.fillRect(x + col * scale, y + row * scale,
                          scale, scale, color);
        }
      } else {
        if (scale == 1) {
          sprite.drawPixel(x + col, y + row, bg);
        } else {
          sprite.fillRect(x + col * scale, y + row * scale,
                          scale, scale, bg);
        }
      }
    }
  }
}

void FontGB2312::drawText(TFT_eSprite& sprite, int16_t x, int16_t y,
                          const String& text, uint16_t color,
                          uint16_t bg, uint8_t scale) {
  if (scale == 0) scale = 1;
  const char* s = text.c_str();
  size_t i = 0;
  int16_t cursorX = x;

  while (s[i]) {
    uint32_t code = utf8Next(s, i);
    if (code == '\n') {
      cursorX = x;
      y += 16 * scale;
      continue;
    }
    if (code == '\r') continue;

    drawGlyph(sprite, cursorX, y, code, color, bg, scale);
    cursorX += glyphWidth(code, scale);
  }
}

void FontGB2312::drawCenterString(TFT_eSprite& sprite, int16_t centerX,
                                  int16_t y, const String& text,
                                  uint16_t color, uint16_t bg,
                                  uint8_t scale) {
  int16_t w = textWidth(text, scale);
  drawText(sprite, centerX - w / 2, y, text, color, bg, scale);
}

void FontGB2312::drawRightString(TFT_eSprite& sprite, int16_t rightX,
                                 int16_t y, const String& text,
                                 uint16_t color, uint16_t bg,
                                 uint8_t scale) {
  int16_t w = textWidth(text, scale);
  drawText(sprite, rightX - w, y, text, color, bg, scale);
}
